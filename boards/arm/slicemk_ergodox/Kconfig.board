## boards/arm/slicemk_ergodox/Kconfig.board
```kconfig
config BOARD_SLICEMK_ERGODOX_LEFT
    bool "SliceMK ErgoDox Left"
    depends on SOC_NRF52833_QIAA

config BOARD_SLICEMK_ERGODOX_RIGHT
    bool "SliceMK ErgoDox Right"
    depends on SOC_NRF52833_QIAA
```

## boards/arm/slicemk_ergodox/Kconfig.defconfig
```kconfig
if BOARD_SLICEMK_ERGODOX_LEFT || BOARD_SLICEMK_ERGODOX_RIGHT

config BOARD
    default "SliceMK ErgoDox 202207 Green"

if USB

config USB_NRFX
    default y

config USB_DEVICE_STACK
    default y

endif # USB

config BT_CTLR
    default BT

endif # BOARD_SLICEMK_ERGODOX_LEFT || BOARD_SLICEMK_ERGODOX_RIGHT
```
